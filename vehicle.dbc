VERSION ""

NS_ :

BS_:

BU_: Vector__XXX

BO_ 256 VehicleStatus: 8 Vector__XXX
 SG_ VehicleSpeed : 0|16@1+ (0.01,0) [0|120] "km/h" Vector__XXX
 SG_ EngineRPM : 16|16@1+ (1,0) [800|5000] "rpm" Vector__XXX

BO_ 257 ThermalFuel: 8 Vector__XXX
 SG_ CoolantTemperature : 0|16@1+ (0.1,-40) [-40|120] "degC" Vector__XXX
 SG_ FuelLevel : 16|8@1+ (0.5,0) [0|100] "%" Vector__XXX

BO_ 258 PowerStatus: 8 Vector__XXX
 SG_ BatteryVoltage : 0|16@1+ (0.01,0) [11|15] "V" Vector__XXX
 SG_ AmbientTemperature : 16|8@1+ (1,-40) [-40|100] "degC" Vector__XXX

CM_ BO_ 256 "Vehicle dynamic status: road speed and engine speed.";
CM_ BO_ 257 "Thermal and fuel status: coolant temperature and fuel level.";
CM_ BO_ 258 "Power supply and ambient conditions.";
CM_ SG_ 256 VehicleSpeed "Unsigned little-endian speed, 0.01 km/h per bit.";
CM_ SG_ 256 EngineRPM "Unsigned little-endian engine speed, 1 rpm per bit.";
CM_ SG_ 257 CoolantTemperature "Raw value uses 0.1 degC/bit with -40 degC offset.";
CM_ SG_ 257 FuelLevel "Unsigned fuel percentage, 0.5 percent per bit.";
CM_ SG_ 258 BatteryVoltage "Unsigned battery voltage, 0.01 V per bit.";
CM_ SG_ 258 AmbientTemperature "Raw value uses 1 degC/bit with -40 degC offset.";
